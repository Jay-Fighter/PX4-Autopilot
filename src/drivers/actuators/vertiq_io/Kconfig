## src/drivers/actuators/vertiq_io/Kconfig
```kconfig
menuconfig DRIVERS_ACTUATORS_VERTIQ_IO
	bool "vertiq_io"
	default n
	---help---
		Enable support for vertiq_io

if DRIVERS_ACTUATORS_VERTIQ_IO
	config USE_IFCI_CONFIGURATION
	bool "Include IFCI Configuration Parameters"
	default n

	config VERTIQ_IO_TESTING
        bool "Enable Vertiq IO Testing Flag"
        default n

	if USE_IFCI_CONFIGURATION
		config USE_PULSING_CONFIGURATION
		bool "Include Pulsing Module Configuration Parameters"
		default n
	endif
endif
```

## src/drivers/omni_swashplateless/Kconfig
```kconfig
menuconfig DRIVERS_OMNI_SWASHPLATELESS
	bool "omni_swashplateless"
	default y
	---help---
		Enable support for omni_swashplateless
```

## src/drivers/omni_uart_io/Kconfig
```kconfig
menuconfig DRIVERS_OMNI_UART_IO
	bool "omni_serial_interface"
	default y
	---help---
		Enable support for omni_uart_io
```

## src/examples/pwm_cap/Kconfig
```kconfig
menuconfig EXAMPLES_PWM_CAP
	bool "pwm_cap"
	default n
	---help---
		Enable support for pwm_cap
```

## src/examples/vertiq_actuator_dev/Kconfig
```kconfig
menuconfig EXAMPLES_VERTIQ_ACTUATOR_DEV
	bool "voltage_superposition_helper"
	default y
	---help---
		Enable support for voltage superposition test
```
